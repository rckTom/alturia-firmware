## boards/alturia/alturia_v1_2/Kconfig.alturia_v1_2
```kconfig
# SPDX-License-Identifier: Apache-2.0

config BOARD_ALTURIA_V1_2
	select SOC_STM32F405XX
```

## boards/alturia/alturia_v1_2/alturia_v1_2_defconfig
```kconfig
# SOC configuration
CONFIG_CORTEX_M_SYSTICK=y
CONFIG_SYS_CLOCK_HW_CYCLES_PER_SEC=168000000
CONFIG_FPU=y

# Pheripheral configuration
CONFIG_PINCTRL=y
CONFIG_SPI=y
CONFIG_PWM=y
CONFIG_SERIAL=y

# GPIO configuration
CONFIG_GPIO=y

# SPI NOR Flash configuration
CONFIG_FLASH=y
CONFIG_SPI_NOR=y
CONFIG_SPI_NOR_SFDP_DEVICETREE=y

# RCC
CONFIG_CLOCK_CONTROL=y
```

## boards/arm/alturia/alturia_defconfig
```kconfig
# SPDX-License-Identifier: Apache-2.0
CONFIG_BOARD_ALTURIA=y
CONFIG_SOC_SERIES_STM32F3X=y
CONFIG_SOC_STM32F303XC=y
CONFIG_CORTEX_M_SYSTICK=y

# 72MHz system clock
CONFIG_SYS_CLOCK_HW_CYCLES_PER_SEC=72000000

# Floating Point Options
CONFIG_FLOAT=y

# enable uart driver
CONFIG_SERIAL=y
CONFIG_UART_1=y

#enable PWM
CONFIG_PWM=y

#enable SPI
CONFIG_SPI=y
CONFIG_SPI_1=y
CONFIG_SPI_2=y

#sensor
CONFIG_SENSOR_LOG_LEVEL_DBG=y
CONFIG_SENSOR=y
CONFIG_MS5607=y
CONFIG_BMI088_GYRO=y
CONFIG_BMI088_ACCEL=y

# enable pinmux
CONFIG_PINMUX=y

# enable GPIO
CONFIG_GPIO=y

# enable flash
CONFIG_FLASH=y
CONFIG_SPI_NOR=y
CONFIG_SPI_NOR_FLASH_LAYOUT_PAGE_SIZE=262144

# clock configuration
CONFIG_CLOCK_CONTROL=y

# Clock configuration for Cube Clock control driver
CONFIG_CLOCK_STM32_SYSCLK_SRC_PLL=y

# use HSE as PLL input
CONFIG_CLOCK_STM32_HSE_CLOCK=24000000
CONFIG_CLOCK_STM32_PLL_SRC_HSE=y

# produce 72MHz clock at PLL output
CONFIG_CLOCK_STM32_PLL_PREDIV=1
CONFIG_CLOCK_STM32_PLL_MULTIPLIER=3
CONFIG_CLOCK_STM32_AHB_PRESCALER=1
CONFIG_CLOCK_STM32_APB1_PRESCALER=2
CONFIG_CLOCK_STM32_APB2_PRESCALER=1
CONFIG_CLOCK_STM32_MCO1_SRC_NOCLOCK=y
CONFIG_CLOCK_STM32_MCO2_SRC_NOCLOCK=y
```

## boards/arm/alturia_v1_2/Kconfig.board
```kconfig
config BOARD_ALTURIA_V1_2
	bool "Alturia Altimeter Hardware Version 1.2"
	depends on SOC_STM32F405XG
```

## boards/arm/alturia_v1_2/alturia_v1_2_defconfig
```kconfig
CONFIG_BOARD_ALTURIA_V1_2=y

# SOC configuration
CONFIG_SOC_SERIES_STM32F4X=y
CONFIG_SOC_STM32F405XG=y
CONFIG_CORTEX_M_SYSTICK=y
CONFIG_SYS_CLOCK_HW_CYCLES_PER_SEC=168000000
CONFIG_FPU=y

# Pheripheral configuration
CONFIG_PINCTRL=y
CONFIG_SPI=y
CONFIG_PWM=y
CONFIG_SERIAL=y

# GPIO configuration
CONFIG_GPIO=y

# SPI NOR Flash configuration
CONFIG_FLASH=y
CONFIG_SPI_NOR=y
CONFIG_SPI_NOR_SFDP_DEVICETREE=y

# RCC
CONFIG_CLOCK_CONTROL=y
```
